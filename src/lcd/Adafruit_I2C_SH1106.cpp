
#include <Arduino.h>
#include <Wire.h>
#include "Adafruit_I2C_SH1106.h"

#define sh1106_swap(a, b) { int16_t t = a; a = b; b = t; }
#define BUFFER_SIZE (SH1106_LCDHEIGHT * SH1106_LCDWIDTH / 8)

static uint8_t buffer[BUFFER_SIZE] = {
// 'eqxP', 128x64px
0x00, 0x00, 0x00, 0x00, 0x00, 0x00, 0x00, 0x00, 0x00, 0x00, 0x00, 0x00, 0x00, 0x00, 0x00, 0x00, 
0x00, 0x00, 0x00, 0x00, 0x00, 0x00, 0x00, 0x00, 0x00, 0x00, 0x00, 0x00, 0x00, 0x00, 0x00, 0x00, 
0x00, 0x00, 0x00, 0x00, 0x00, 0x00, 0x00, 0x00, 0x00, 0x00, 0x00, 0x00, 0x00, 0x00, 0x00, 0x00, 
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0x00, 0x00, 0x00, 0x00, 0x00, 0x00, 0x00, 0x00, 0x00, 0x00, 0x00, 0x00, 0x00, 0x00, 0x00, 0x00
	};

/************************************************
 *
 ***********************************************/
Adafruit_I2C_SH1106::Adafruit_I2C_SH1106()
	: Adafruit_GFX(SH1106_LCDWIDTH, SH1106_LCDHEIGHT)
{

}


/************************************************
 * Push a copy of the buffer to the display
 ***********************************************/
void Adafruit_I2C_SH1106::flushDisplay()
{
	this->flush(false);
}

/************************************************
 * Push a complete copy of our display buffer to the OLED.
 * if clear is set to true, then instead of our buffer,
 * 0x00 will be pushed instead.
 ***********************************************/
void Adafruit_I2C_SH1106::flush(bool clear)
{

	/* 8 pages (rows) of 8 pixels each row */
	int bufferIndex = 0;
	for (int page = 0; page < SH1106_PAGES; page++)
	{

		for (int col = 0; col < SH1106_COLUMNS; col++)
		{

			setSegment(page, col);

			/* Quick fire 8 bytes for this write op */
			/* Turn on data mode */
			Wire.beginTransmission(OLED_address);
			Wire.write(0x40);
			for (int index = 0; index < 8; index++)
			{
				Wire.write(clear ? 0 : buffer[bufferIndex++]);
			}
			Wire.endTransmission();
		}
	}

 }

 /***********************************************
  * Copied straight out of the Adafruit SSD1306 driver.
  **********************************************/
 void Adafruit_I2C_SH1106::drawPixel(int16_t x, int16_t y, uint16_t color)
 {
   if ((x < 0) || (x >= width()) || (y < 0) || (y >= height()))
     return;

   // check rotation, move pixel around if necessary
   switch (getRotation())
   {
	   case 1:
	     sh1106_swap(x, y);
	     x = SH1106_LCDWIDTH - x - 1;
	     break;
	   case 2:
	     x = SH1106_LCDWIDTH - x - 1;
	     y = SH1106_LCDHEIGHT - y - 1;
	     break;
	   case 3:
	     sh1106_swap(x, y);
	     y = SH1106_LCDHEIGHT - y - 1;
	     break;
   }

    switch (color)
     {
       case WHITE:   buffer[x+ (y/8)*SH1106_LCDWIDTH] |=  (1 << (y&7)); break;
       case BLACK:   buffer[x+ (y/8)*SH1106_LCDWIDTH] &= ~(1 << (y&7)); break;
       case INVERSE: buffer[x+ (y/8)*SH1106_LCDWIDTH] ^=  (1 << (y&7)); break;
     }

 }

 /************************************************
  *
  ***********************************************/
void Adafruit_I2C_SH1106::resetDisplay(void)
{
  displayOff();
  clearDisplay();
  displayOn();
}

/************************************************
 *
 ***********************************************/
void Adafruit_I2C_SH1106::displayOn(void)
{
  sendcommand(0xaf);        //display on
}

/************************************************
 *
 ***********************************************/
void Adafruit_I2C_SH1106::displayOff(void)
{
  sendcommand(0xae);    //display off
}

// // clear everything
// void Adafruit_SSD1306::clearDisplay(void) {
//   memset(buffer, 0, (SSD1306_LCDWIDTH*SSD1306_LCDHEIGHT/8));
// }

/************************************************
 * Clears the display by sendind 0 to the screen map.
 ***********************************************/
void Adafruit_I2C_SH1106::clearDisplay(void)
{
	flush(true);
}

/************************************************
 *
 ***********************************************/
void Adafruit_I2C_SH1106::sendcommand(unsigned char com)
{
  Wire.beginTransmission(OLED_address);     //begin transmitting
  Wire.write(0x80);                          //command mode
  Wire.write(com);
  Wire.endTransmission();                    // stop transmitting
}

/************************************************
 * Set the memory location to the given page and column
 ***********************************************/
void Adafruit_I2C_SH1106::setSegment(unsigned char page ,unsigned char col)
{
  sendcommand(0xb0+page);                //set page address
  sendcommand(offset+(8*col&0x0f));       //set low col address
  sendcommand(0x10+((8*col>>4)&0x0f));  //set high col address
}


/************************************************
 * Inits oled and draws logo at startup.  i2c wire
 * must already be configured
 ***********************************************/
void Adafruit_I2C_SH1106::init(void)
{

	sendcommand(0xae);    //display off
	sendcommand(0xa6);            //Set Normal Display (default)
    // Adafruit Init sequence for 128x64 OLED module
    sendcommand(0xAE);             //DISPLAYOFF
    sendcommand(0xD5);            //SETDISPLAYCLOCKDIV
    sendcommand(0x80);            // the suggested ratio 0x80
    sendcommand(0xA8);            //SSD1306_SETMULTIPLEX
    sendcommand(0x3F);
    sendcommand(0xD3);            //SETDISPLAYOFFSET
    sendcommand(0x0);             //no offset
    sendcommand(0x40 | 0x0);      //SETSTARTLINE
    sendcommand(0x8D);            //CHARGEPUMP
    sendcommand(0x14);
    sendcommand(0x20);             //MEMORYMODE
    sendcommand(0x00);             //0x0 act like ks0108

    //sendcommand(0xA0 | 0x1);      //SEGREMAP   //Rotate screen 180 deg
    sendcommand(0xA0);

    //sendcommand(0xC8);            //COMSCANDEC  Rotate screen 180 Deg
    sendcommand(0xC0);

    sendcommand(0xDA);            //0xDA
    sendcommand(0x12);           //COMSCANDEC
    sendcommand(0x81);           //SETCONTRAS
    sendcommand(0xFF);           // 0xCF was original
    sendcommand(0xd9);          //SETPRECHARGE
    sendcommand(0xF1);
    sendcommand(0xDB);        //SETVCOMDETECT
    sendcommand(0x40);
    sendcommand(0xA4);        //DISPLAYALLON_RESUME
    sendcommand(0xA6);        //NORMALDISPLAY

	// clearDisplay();
	sendcommand(0x2e);            // stop scroll
	//----------------------------REVERSE comments----------------------------//
    sendcommand(0xa0);    //seg re-map 0->127(default)
    sendcommand(0xa1);    //seg re-map 127->0
    sendcommand(0xc8);
    delay(1000);
	//----------------------------REVERSE comments----------------------------//
	// sendcommand(0xa7);  //Set Inverse Display
	// sendcommand(0xae);   //display off
	sendcommand(0x20);            //Set Memory Addressing Mode
	sendcommand(0x00);            //Set Memory Addressing Mode ab Horizontal addressing mode
	//  sendcommand(0x02);         // Set Memory Addressing Mode ab Page addressing mode(RESET)

	resetDisplay();
	flushDisplay();
}
